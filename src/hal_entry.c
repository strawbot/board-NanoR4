#include "hal_data.h"
#include "r_ioport.h"

#include "tea.h"
#include "cli.h"
#include "clocks.h"
#include "cli_transport_usart.h"
#include "usb_init.h"
#include "canary.h"
#include "board_cli.h"
#include "i2c0.h"
#include "ad5593r.h"
#include "printers.h"

void muscle_wire_init(void);

static const ad5593r_hw_t g_ad5593r_hw = {
    .i2c_write = i2c0_write,
    .i2c_read  = i2c0_read,
};

static bool g_ad5593r_ok;

// init_cli is defined in TimbreOS/cli.c but not declared in cli.h —
// follow the convention used by the other board ports.
void init_cli(void);

// Three quick LED pulses on the yellow user LED (P204). Used as a "firmware
// is alive" sanity check before the transport is up. Runs off a busy-loop,
// not the timer, so it's valid even if the scheduler hasn't started.
void blink() {
    R_IOPORT_PinWrite(&g_ioport_ctrl, BSP_IO_PORT_02_PIN_04, BSP_IO_LEVEL_HIGH);
    for (volatile uint32_t w = 0; w < 400000; w++) { __asm volatile ("nop"); }
    R_IOPORT_PinWrite(&g_ioport_ctrl, BSP_IO_PORT_02_PIN_04, BSP_IO_LEVEL_LOW);
    for (volatile uint32_t w = 0; w < 400000; w++) { __asm volatile ("nop"); }
}

#if (1 == BSP_MULTICORE_PROJECT) && BSP_TZ_SECURE_BUILD
bsp_ipc_semaphore_handle_t g_core_start_semaphore =
{
    .semaphore_num = 0
};
#endif

/*******************************************************************************************************************//**
 * main() is generated by the RA Configuration editor and is used to generate threads if an RTOS is used.  This function
 * is called by main() when no RTOS is used.
 **********************************************************************************************************************/
void hal_entry(void)
{
    /* Arduino Nano R4 quirk: the DFU bootloader jumps to user code via direct
     * register manipulation (not NVIC_SystemReset), leaving PRIMASK=1 and VTOR
     * still at 0x0 (bootloader vectors). Fix both before anything else runs:
     *   - VTOR: user vectors live at 0x4000 (bootloader owns 0x0–0x3FFF)
     *   - PRIMASK: clear so FSP init, USB, and the scheduler work correctly */
    SCB->VTOR = 0x00004000UL;
    __enable_irq();

    /* Visible "firmware alive" marker — three short LED pulses before we
     * touch the scheduler or transport. If you don't see this after reset,
     * the firmware isn't reaching hal_entry at all (check VTOR / memory
     * regions / upload). */

    /* Enable the DWT cycle counter for hi-res timing (sysTicks()).
     * Required by project_defs.h: #define sysTicks() (Long)(DWT->CYCCNT) */
    CoreDebug->DEMCR |= CoreDebug_DEMCR_TRCENA_Msk;
    DWT->CYCCNT = 0;
    DWT->CTRL   |= DWT_CTRL_CYCCNTENA_Msk;

    /* Wake up 2nd core if this is first core and we are inside a multicore project. */
#if (0 == _RA_CORE) && (1 == BSP_MULTICORE_PROJECT) && !BSP_TZ_NONSECURE_BUILD

#if BSP_TZ_SECURE_BUILD
    /* Take semaphore so 2nd core can clear it */
    R_BSP_IpcSemaphoreTake(&g_core_start_semaphore);
#endif

    R_BSP_SecondaryCoreStart();

#if BSP_TZ_SECURE_BUILD
    /* Wait for 2nd core to start and clear semaphore */
    while(FSP_ERR_IN_USE == R_BSP_IpcSemaphoreTake(&g_core_start_semaphore))
    {
        ;
    }
#endif
#endif

#if (1 == _RA_CORE) && (1 == BSP_MULTICORE_PROJECT) && BSP_TZ_SECURE_BUILD
    /* Signal to 1st core that 2nd core has started */
    R_BSP_IpcSemaphoreGive(&g_core_start_semaphore);
#endif


#if BSP_TZ_SECURE_BUILD
    /* Enter non-secure code */
    R_BSP_NonSecureEnter();
#endif

    stack_canary_init();   /* fill stack with 0xDEADBEEF before any deep calls */

    /* TimbreOS bring-up. init_tea() calls init_clocks() internally
     * (see TimbreOS/tea.c:init_tea) so we do NOT call init_clocks() again.
     * The build banner is printed *after* usart_transport_init() because
     * init_clocks runs before the transport is up, and output() will spin
     * forever if emitq has no drain path. */
    dac_init();
    adc_init();
    muscle_wire_init();   // open GPT3 PWM on P003 before scheduler starts
    i2c0_init();          // IIC0: SCL=P400, SDA=P401, 400 kHz
    ad5593r_bind_hw(&g_ad5593r_hw);
    g_ad5593r_ok = ad5593r_init();
    init_tea();
    usart_transport_init();
    usb_transport_init();
    print_build_banner();
    print(" [diag:usb-ok]");
    print(g_ad5593r_ok ? " [diag:ad5593-ok]" : " [diag:ad5593-FAIL]");
    init_cli();
    print(" [diag:cli-ok]");

    while (1) {
        run();
        micro_sleep();   // __WFI — wake on any interrupt (timer, UART RX/TX)
    }
}

#if BSP_TZ_SECURE_BUILD

FSP_CPP_HEADER
BSP_CMSE_NONSECURE_ENTRY void template_nonsecure_callable ();

/* Trustzone Secure Projects require at least one nonsecure callable function in order to build (Remove this if it is not required to build). */
BSP_CMSE_NONSECURE_ENTRY void template_nonsecure_callable ()
{

}
FSP_CPP_FOOTER

#endif
